## boards/shields/sp_et6/Kconfig.defconfig
```kconfig
if SHIELD_SPET6_RIGHT

config ZMK_KEYBOARD_NAME
    default "SP-ET6"

config ZMK_SPLIT_ROLE_CENTRAL
    default y

config ZMK_SPLIT_BLE_CENTRAL_PERIPHERALS
    default 1

# Max pair + 1 (+1 for peripheral)
config BT_MAX_CONN
    default 6

# Set this to the same number as BT_MAX_CONN
config BT_MAX_PAIRED
    default 6


endif

if SHIELD_SPET6_LEFT 
config ZMK_SPLIT_ROLE_CENTRAL
    default n
endif

if SHIELD_SPET6_LEFT || SHIELD_SPET6_RIGHT

config ZMK_SPLIT
    default y
    
endif
```

## boards/shields/sp_et6/Kconfig.shield
```kconfig
# Copyright (c) 2020 Pete Johanson
# SPDX-License-Identifier: MIT

config SHIELD_SPET6_LEFT
    def_bool $(shields_list_contains,spet6_left)

config SHIELD_SPET6_RIGHT
    def_bool $(shields_list_contains,spet6_right)
```

## config/west.yml
```yaml
manifest:
  defaults:
    revision: v0.3
  remotes:
    - name: zmkfirmware
      url-base: https://github.com/zmkfirmware
    # Additional modules containing boards/shields/custom code can be listed here as well
    # See https://docs.zephyrproject.org/3.2.0/develop/west/manifest.html#projects
    - name: nykxx
      url-base: https://github.com/nykxx/
    - name: prospector
      url-base: https://github.com/t-ogura
  projects:
    - name: zmk
      remote: zmkfirmware
      revision: main
      import: app/west.yml
    - name: zmk-pmw3610-driver
      remote: nykxx
      revision: main
    - name: prospector-zmk-module
      remote: prospector
      revision: v1.0.0
      path: modules/prospector-zmk-module
  self:
    path: config
```
